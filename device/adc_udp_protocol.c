#include "adc_udp_protocol.h"
#include <string.h>

uint16_t AdcUdp_Crc16(const uint8_t *data, uint32_t len)
{
    static const uint16_t s_crc_table[256] =
    {
        0x0000U, 0xC0C1U, 0xC181U, 0x0140U, 0xC301U, 0x03C0U, 0x0280U, 0xC241U, 0xC601U, 0x06C0U, 0x0780U, 0xC741U, 0x0500U, 0xC5C1U, 0xC481U, 0x0440U,
        0xCC01U, 0x0CC0U, 0x0D80U, 0xCD41U, 0x0F00U, 0xCFC1U, 0xCE81U, 0x0E40U, 0x0A00U, 0xCAC1U, 0xCB81U, 0x0B40U, 0xC901U, 0x09C0U, 0x0880U, 0xC841U,
        0xD801U, 0x18C0U, 0x1980U, 0xD941U, 0x1B00U, 0xDBC1U, 0xDA81U, 0x1A40U, 0x1E00U, 0xDEC1U, 0xDF81U, 0x1F40U, 0xDD01U, 0x1DC0U, 0x1C80U, 0xDC41U,
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        0x4400U, 0x84C1U, 0x8581U, 0x4540U, 0x8701U, 0x47C0U, 0x4680U, 0x8641U, 0x8201U, 0x42C0U, 0x4380U, 0x8341U, 0x4100U, 0x81C1U, 0x8081U, 0x4040U
    };

    uint16_t crc = 0xFFFFU;
    for (uint32_t i = 0; i < len; i++)
    {
        crc = (uint16_t)((crc >> 8) ^ s_crc_table[(crc ^ data[i]) & 0xFFU]);
    }
    return crc;
}


static void put16(uint8_t *p, uint16_t v)
{
    p[0] = (uint8_t)v;
    p[1] = (uint8_t)(v >> 8);
}
static void put32(uint8_t *p, uint32_t v)
{
    put16(p, (uint16_t)v);
    put16(p + 2, (uint16_t)(v >> 16));
}

uint16_t AdcUdp_MaxSamples(uint16_t mtu, uint8_t bps)
{
    uint16_t limit;
    if ((mtu <= 56U) || ((bps != 2U) && (bps != 3U))) return 0U;
    limit = (uint16_t)(mtu - 28U);
    if (limit > APP_UDP_MAX_PAYLOAD) limit = APP_UDP_MAX_PAYLOAD;
    return (uint16_t)((limit - APP_FRAME_HDR_LEN - APP_DATA_META_LEN - APP_FRAME_CRC_LEN) / bps);
}

uint16_t AdcUdp_BuildData(uint8_t *out, uint16_t capacity, uint32_t frame_seq,
                        const AppConfig_t *cfg, uint32_t first_sample,
                        const uint8_t *samples, uint16_t count, uint8_t bps)
{
    uint32_t bytes = (uint32_t)count * bps;
    uint32_t total = APP_FRAME_HDR_LEN + APP_DATA_META_LEN + bytes + APP_FRAME_CRC_LEN;
    uint8_t *p;
    if (!out || !samples || !AppConfig_IsValid(cfg) || !count ||
        bps != AppConfig_BytesPerSample(cfg) || total > capacity ||
        total > APP_UDP_MAX_PAYLOAD) return 0U;
    put16(out, APP_PROTO_MAGIC);
    out[2] = APP_PROTO_VER;
    out[3] = APP_TYPE_DATA;
    put16(out + 4, (uint16_t)(APP_DATA_META_LEN + bytes));
    put32(out + 6, frame_seq);
    p = out + APP_FRAME_HDR_LEN;
    put32(p, AppConfig_ActualFsHz(cfg));
    p[4] = cfg->bits;
    p[5] = cfg->range;
    p[6] = bps;
    p[7] = 0U;
    put32(p + 8, first_sample);
    put16(p + 12, count);
    put16(p + 14, (uint16_t)bytes);
    memcpy(p + APP_DATA_META_LEN, samples, bytes);
    put16(out + total - 2U, AdcUdp_Crc16(out, total - 2U));
    return (uint16_t)total;
}

int AdcUdp_ValidateCommand(const uint8_t *frame, uint16_t len)
{
    uint16_t payload, crc;
    if (!frame || len < 12U || len > APP_UDP_COMMAND_MAX ||
        frame[0] != 0x5AU || frame[1] != 0xA5U || frame[2] != APP_PROTO_VER) return 0;
    payload = (uint16_t)(frame[4] | ((uint16_t)frame[5] << 8));
    if ((uint32_t)payload + 12U != len) return 0;
    crc = (uint16_t)(frame[len - 2U] | ((uint16_t)frame[len - 1U] << 8));
    return crc == AdcUdp_Crc16(frame, len - 2U);
}

